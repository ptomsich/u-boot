## board/sunxi/pine64_atf.its
```
/dts-v1/;

/ {
	description = "Configuration to load ATF before U-Boot";
	#address-cells = <1>;

	images {
		uboot@1 {
			description = "U-Boot (64-bit)";
			data = /incbin/("../../u-boot-nodtb.bin");
			type = "standalone";
			arch = "arm64";
			compression = "none";
			load = <0x4a000000>;
		};
		atf@1 {
			description = "ARM Trusted Firmware";
			data = /incbin/("../../bl31.bin");
			type = "firmware";
			arch = "arm64";
			compression = "none";
			load = <0x44000>;
			entry = <0x44000>;
		};
		fdt@1 {
			description = "Pine64+ DT";
			data = /incbin/("../../arch/arm/dts/sun50i-a64-pine64-plus.dtb");
                        type = "flat_dt";
			compression = "none";
		};
		fdt@2 {
			description = "Pine64 DT";
			data = /incbin/("../../arch/arm/dts/sun50i-a64-pine64.dtb");
                        type = "flat_dt";
			compression = "none";
		};
	};
	configurations {
		default = "config@1";

		config@1 {
			description = "sun50i-a64-pine64-plus";
			firmware = "uboot@1";
			loadables = "atf@1";
			fdt = "fdt@1";
		};
		config@2 {
			description = "sun50i-a64-pine64";
			firmware = "uboot@1";
			loadables = "atf@1";
			fdt = "fdt@2";
		};
	};
};
```

## configs/Bananapi-M64_defconfig
```kconfig
CONFIG_ARM=y
CONFIG_ENABLE_ARM_SOC_BOOT0_HOOK=y
CONFIG_ARCH_SUNXI=y
CONFIG_MACH_SUN50I=y
CONFIG_DEFAULT_DEVICE_TREE="sun50i-a64-bananapi-m64"
# CONFIG_CMD_IMLS is not set
# CONFIG_CMD_FLASH is not set
# CONFIG_CMD_FPGA is not set
CONFIG_SUN8I_EMAC=y
CONFIG_MMC_SUNXI_SLOT_EXTRA=2
```

## configs/lynx_defconfig
```kconfig
CONFIG_ARM=y
CONFIG_RESERVE_ALLWINNER_BOOT0_HEADER=y
CONFIG_ARCH_SUNXI=y
CONFIG_MACH_SUN50I=y
CONFIG_SUNXI_LYNX=y
CONFIG_DEFAULT_DEVICE_TREE="sun50i-a64-lynx"
CONFIG_OF_LIST="sun50i-a64-lynx"
# CONFIG_SYS_MALLOC_CLEAR_ON_INIT is not set
CONFIG_CONSOLE_MUX=y
CONFIG_SPL=y
CONFIG_FIT=y
CONFIG_SPL_FIT=y
CONFIG_SPL_LOAD_FIT=y
CONFIG_SPL_OF_LIBFDT=y
# CONFIG_CMD_IMLS is not set
# CONFIG_CMD_FLASH is not set
# CONFIG_CMD_FPGA is not set
CONFIG_SUN8I_EMAC=y
CONFIG_USB_EHCI_HCD=y

CONFIG_CMD_MMC=y
CONFIG_MMC_SUNXI_SLOT_EXTRA=2


# Support for running the dual-role controller in device-mode
CONFIG_USB_MUSB_GADGET=y
CONFIG_USB_GADGET=y
CONFIG_USB_GADGET_DOWNLOAD=y
CONFIG_USB0_ID_DET="PG4"
CONFIG_USB0_VBUS_DET="PG8"
CONFIG_USB0_VBUS_PIN="PH11"
CONFIG_USB1_VBUS_PIN="PG09"

CONFIG_G_DNL_MANUFACTURER="Theobroma Systems"
CONFIG_G_DNL_VENDOR_NUM=0x18D1
CONFIG_G_DNL_PRODUCT_NUM=0x4EE0

# Support for USB mass storage emulation ('ums' command)
CONFIG_CMD_USB_MASS_STORAGE=y

#
# Fastboot support
#
CONFIG_FASTBOOT=y
CONFIG_USB_FUNCTION_FASTBOOT=y
CONFIG_CMD_FASTBOOT=y
CONFIG_ANDROID_BOOT_IMAGE=y
CONFIG_FASTBOOT_BUF_ADDR=0x42000000
CONFIG_FASTBOOT_BUF_SIZE=0x8000000
CONFIG_FASTBOOT_FLASH=y
CONFIG_FASTBOOT_FLASH_MMC_DEV=1
CONFIG_FASTBOOT_GPT_NAME="gpt"
CONFIG_FASTBOOT_MBR_NAME="mbr"
```

## configs/pangolin_defconfig
```kconfig
CONFIG_SUNXI_PANGOLIN=y
CONFIG_SPL=y
CONFIG_SYS_EXTRA_OPTIONS="USB_EHCI,SUNXI_GMAC,RGMII"
CONFIG_DEFAULT_DEVICE_TREE="sun6i-a31-pangolin"
CONFIG_VIDEO_VGA_VIA_LCD=y
CONFIG_VIDEO_VGA_EXTERNAL_DAC_EN="PH25"
CONFIG_ARM=y
CONFIG_ARMV7_BOOT_SEC_DEFAULT=y
CONFIG_OLD_SUNXI_KERNEL_COMPAT=y
CONFIG_ARCH_SUNXI=y
CONFIG_MACH_SUN6I=y
CONFIG_DRAM_CHANNELS=1
CONFIG_DRAM_CLK=360
CONFIG_DRAM_ZQ=70
CONFIG_DRAM_ODT_EN=y
CONFIG_AXP_DCDC1_VOLT=3300
CONFIG_AXP_ALDO1_VOLT=0
CONFIG_AXP_ALDO2_VOLT=1800
CONFIG_AXP_ALDO3_VOLT=3000
CONFIG_AXP_DLDO4_VOLT=3300
CONFIG_AXP_ELDO1_VOLT=1200
CONFIG_AXP_ELDO2_VOLT=2500
CONFIG_AXP_ELDO3_VOLT=3300
CONFIG_CMD_MMC=y
CONFIG_MMC_SUNXI_SLOT_EXTRA=2
CONFIG_CONS_INDEX=3
# Vbus gpio for usb1
CONFIG_USB1_VBUS_PIN=""
# No Vbus gpio for usb2
CONFIG_USB2_VBUS_PIN=""
CONFIG_USB=y
CONFIG_DM_USB=y
CONFIG_USB_EHCI=y
CONFIG_USB_KEYBOARD=y
CONFIG_DM_ETH=y
CONFIG_CMD_IMLS=n
CONFIG_ETH_DESIGNWARE=y
CONFIG_DM_SPI=y
# CONFIG_DM_SPI_FLASH=y
CONFIG_SUNXI_SPI=y
CONFIG_CMD_DHCP=y
CONFIG_CMD_MII=y
CONFIG_CMD_PING=y
CONFIG_CMD_EXT2=y
CONFIG_CMD_EXT4=y
CONFIG_CMD_FAT=y
CONFIG_CMD_FS_GENERIC=y
CONFIG_ETH_DESIGNWARE=y
CONFIG_USB_EHCI_HCD=y
# CONFIG_USB_MUSB_OTG=y
CONFIG_USB_MUSB_GADGET=y
CONFIG_USB_GADGET=y
CONFIG_USB_GADGET_DOWNLOAD=y
CONFIG_USB0_ID_DET="PH2"
CONFIG_USB0_VBUS_DET="PD23"
CONFIG_USB0_VBUS_PIN="PH30"
CONFIG_G_DNL_MANUFACTURER="Theobroma Systems"
CONFIG_G_DNL_VENDOR_NUM=0x18D1
CONFIG_G_DNL_PRODUCT_NUM=0x0A31
CONFIG_HUSH_PARSER=y
```

## configs/pangolin_elcom_defconfig
```kconfig
CONFIG_SUNXI_PANGOLIN=y
CONFIG_SPL=y
CONFIG_SYS_EXTRA_OPTIONS="USB_EHCI,SUNXI_GMAC,RGMII"
CONFIG_DEFAULT_DEVICE_TREE="sun6i-a31-pangolin-elcom"
CONFIG_CONS_INDEX=1
CONFIG_ARM=y
CONFIG_ARMV7_BOOT_SEC_DEFAULT=y
CONFIG_OLD_SUNXI_KERNEL_COMPAT=y
CONFIG_ARCH_SUNXI=y
CONFIG_MACH_SUN6I=y
CONFIG_DRAM_CHANNELS=1
CONFIG_DRAM_CLK=388
CONFIG_DRAM_ZQ=70
CONFIG_DRAM_ODT_EN=y
CONFIG_AXP_DCDC1_VOLT=3300
CONFIG_AXP_DCDC3_VOLT=1260
CONFIG_AXP_DCDC4_VOLT=1320
CONFIG_AXP_ALDO1_VOLT=0
CONFIG_AXP_ALDO2_VOLT=1800
CONFIG_AXP_ALDO3_VOLT=3000
CONFIG_AXP_DLDO4_VOLT=3300
CONFIG_AXP_ELDO1_VOLT=1200
CONFIG_AXP_ELDO2_VOLT=2500
CONFIG_AXP_ELDO3_VOLT=3300
CONFIG_I2C0_ENABLE=y
CONFIG_I2C1_ENABLE=y
CONFIG_I2C2_ENABLE=y
CONFIG_I2C3_ENABLE=y
CONFIG_CMD_MMC=y
CONFIG_MMC_SUNXI_SLOT_EXTRA=2
# Vbus gpio for usb1
CONFIG_USB1_VBUS_PIN=""
# No Vbus gpio for usb2
CONFIG_USB2_VBUS_PIN=""
CONFIG_USB=y
CONFIG_DM_USB=y
CONFIG_USB_EHCI=y
CONFIG_USB_KEYBOARD=y
CONFIG_DM_ETH=y
CONFIG_CMD_IMLS=n
CONFIG_ETH_DESIGNWARE=y
CONFIG_DM_SPI=y
# CONFIG_DM_SPI_FLASH=y
CONFIG_SUNXI_SPI=y
CONFIG_CMD_DHCP=y
CONFIG_CMD_MII=y
CONFIG_CMD_PING=y
CONFIG_CMD_EXT2=y
CONFIG_CMD_EXT4=y
CONFIG_CMD_FAT=y
CONFIG_CMD_FS_GENERIC=y
CONFIG_CMD_I2C=y
CONFIG_ETH_DESIGNWARE=y
CONFIG_USB_EHCI_HCD=y
# CONFIG_USB_MUSB_OTG=y
CONFIG_USB_MUSB_GADGET=y
CONFIG_USB_GADGET=y
CONFIG_USB_GADGET_DOWNLOAD=y
CONFIG_USB0_ID_DET="PH2"
CONFIG_USB0_VBUS_DET="PD23"
CONFIG_USB0_VBUS_PIN="PH30"
CONFIG_G_DNL_MANUFACTURER="Theobroma Systems"
CONFIG_G_DNL_VENDOR_NUM=0x18D1
CONFIG_G_DNL_PRODUCT_NUM=0x4EE0
CONFIG_HUSH_PARSER=y
# CONFIG_VIDEO is not set
CONFIG_CMD_USB_MASS_STORAGE=y
# CONFIG_CMD_LOADB is not set
# CONFIG_CMD_LOADS is not set

#
# Fastboot support
#
CONFIG_FASTBOOT=y
CONFIG_USB_FUNCTION_FASTBOOT=y
CONFIG_CMD_FASTBOOT=y
CONFIG_ANDROID_BOOT_IMAGE=y
CONFIG_FASTBOOT_BUF_ADDR=0x42000000
CONFIG_FASTBOOT_BUF_SIZE=0x8000000
CONFIG_FASTBOOT_FLASH=y
CONFIG_FASTBOOT_FLASH_MMC_DEV=1
CONFIG_FASTBOOT_GPT_NAME="gpt"
CONFIG_FASTBOOT_MBR_NAME="mbr"
```
